#include <WiFi.h>            //библиотека для работы с вайфай
#include <PubSubClient.h>    //библиотека для подключения к серверу
#include <Wire.h>            //библиотека для работы с доп модулями

////////////////////// Настройки //////////////////////
// Wi-Fi
const char* ssid = "Quantorium";
const char* password = "123789456";

const char* mqtt_server = "m8.wqtt.ru";  //адрес
int mqtt_port = 17120;               //порт
const char* mqtt_login = "u_S4ED9W";    // пользователь
const char* mqtt_pass = "WlvkOVC5";     //пароль

//стандартные параметры для подключения к вайфай
WiFiClient espClient;
PubSubClient client(espClient);
unsigned long lastMsg = 0;
#define MSG_BUFFER_SIZE (50)
char msg[MSG_BUFFER_SIZE];
int value = 0;

#include "TLC59108.h" // библиотека для модуля MGL_RGB1 - светодиод
#define HW_RESET_PIN 0 // Только програмнный сброс
#define I2C_ADDR TLC59108::I2C_ADDR::BASE
TLC59108 leds(I2C_ADDR + 7); // Без перемычек добавляется 3 бита адреса
TLC59108 leds2(I2C_ADDR + 0); // Все перемычки на модуле стоят
TLC59108 leds3(I2C_ADDR + 6); // Стоит только одна перемычка

#include <ESP32_Servo.h>                      // конфигурация сервомотора // servo configuration

#define sensor_addr 0x39         // датчик пламени
float ir_data = 0;               // инфракрасный спектр
float vis_data = 0;              // визуальный спектр

#include <Adafruit_MCP4725.h>                           // динамик
Adafruit_MCP4725 buzzer;
int ton;
int vol1 = 1000; // Уровень громкости = vol1-vol2
int vol2 = 900;  //

#include <I2C_graphical_LCD_display.h>            // дисплей
I2C_graphical_LCD_display lcd;

#define  wind   17                     // пин вентилятора (16)
#define  amper  14                     // пин амперметра
#define  button 4                      // пин кнопки

Servo myservo;
int pos = 1;            // начальная позиция сервомотора // servo start position
int prevangle = 1;      // предыдущий угол сервомотора // previous angle of servo

const byte picture [] PROGMEM = {      // картинка
  0x00, 0x00, 0x00, 0x00, 0x00, 0x00, 0x00, 0x00, 0x00, 0x00, 0x00, 0x00, 0x00, 0x00, 0x00, 0x00,
  0x00, 0x00, 0x00, 0x00, 0x00, 0x00, 0x00, 0x00, 0x00, 0x00, 0x00, 0x00, 0x00, 0x00, 0x00, 0x00,
  0x00, 0x00, 0x00, 0x00, 0x00, 0x00, 0x00, 0x00, 0x00, 0x00, 0x00, 0x00, 0x00, 0x00, 0x00, 0x00,
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  0x00, 0x00, 0x00, 0x00, 0x00, 0x00, 0x00, 0x00, 0x00, 0x00, 0x00, 0x00, 0x00, 0x00, 0x00, 0x00
};

void setup()
{
  Serial.begin(115200);          // включение монитора порта
  delay(512);

  setup_wifi();
  client.setServer(mqtt_server, mqtt_port);
  client.setCallback(callback);

  myservo.attach(13);            // пин сервомотора

  init_sensor();                 //включаем датчик огня

  pinMode(button, INPUT);        // настройка пина кнопки на выход 
  pinMode(wind, OUTPUT);         // настройка пина вентилятора на выход 
  //digitalWrite(wind, LOW);       // выключение вентиляции при запуске

  Wire.begin();                  // включение библиотеки Wire, нужна для подключения устройств по протоколу I2C

  leds.init(HW_RESET_PIN);
  leds.setLedOutputMode(TLC59108::LED_MODE::PWM_IND);
  leds2.init(HW_RESET_PIN);
  leds2.setLedOutputMode(TLC59108::LED_MODE::PWM_IND);
  leds3.init(HW_RESET_PIN);
  leds3.setLedOutputMode(TLC59108::LED_MODE::PWM_IND);

  buzzer.begin(0x61);            // установка адреса для пьезоэлемента, с перемычкой адрес будет 0x60
  buzzer.setVoltage(0, false);   // выключение звука
  delay(150);

  ledcSetup(5, 50, 10);
  ledcAttachPin(amper, 5);       // инициализация амперметра

  //mcp3021.begin(adcDeviceId);
}

uint32_t tmr1;
const char* ir_topic = "IK_data";

//Main program
void loop()
{
  if (!client.connected()) {
    reconnect();
  }
  client.loop();

  poll_sensor();
  Serial.println("Visible = " + String(vis_data, 1) + " μW/cm2");
  Serial.println("IR = " + String(ir_data, 1) + " μW/cm2");
  if (millis() -tmr1 >= (5 * 1000)) {
    tmr1 = millis();
    send_data();
  }
  
  delay(150);

  if (ir_data >= 800) {
    on_alarm();
  }

  Serial.println("====================================================================================================");
}

//MQTT connection
void setup_wifi() {
  delay(10);
  // Подключение к сети
  Serial.println();
  Serial.print("Connecting to ");
  Serial.println(ssid);

  WiFi.mode(WIFI_STA);
  WiFi.begin(ssid, password);

  while (WiFi.status() != WL_CONNECTED) {
    delay(500);
    Serial.print(".");
  }

  randomSeed(micros());

  Serial.println("");
  Serial.println("WiFi connected");
  Serial.println("IP address: ");
  Serial.println(WiFi.localIP());
}

// функция приёма и обработки пакета данных
void callback(char* topic, byte* payload, unsigned int length) {
  Serial.print("Message arrived [");
  Serial.print(topic);
  Serial.print("] ");
  for (int i = 0; i < length; i++) {
    Serial.print((char)payload[i]);
  }
  Serial.println();
  Serial.println(String(topic));

  if (String(topic) == "Light") {
    on_off_light((char)payload[0]);
  }
  if (String(topic) == "Elec") {
    on_off_power((char)payload[0]);
  }
  if (String(topic) == "Door") {
    open_close_door((char)payload[0]);
  }
  if (String(topic) == "Vent") {
    on_off_cooler((char)payload[0]);
  }
  if (String(topic) == "Fire") {
    off_alarm((char)payload[0]);
  }
  if (String(topic) == "TV") {
    generic_TV_picture((char)payload[0]);
  }
}

// Подключение к серверу
void reconnect() {
  // Ждем, пока не подсоединимся
  while (!client.connected()) {
    Serial.print("Attempting MQTT connection...");
    // Создается случайный номер клиента
    String clientId = "IoTik32Client-";
    clientId += String(random(0xffff), HEX);
    // Попытка подключения
    if (client.connect(clientId.c_str(), mqtt_login, mqtt_pass)) {
      Serial.println("connected");
      // ... и подписки на топик
      client.subscribe("Fire");
      client.subscribe("Elec");
      client.subscribe("Vent");
      client.subscribe("Door");
      client.subscribe("Light");
      client.subscribe("TV");
      client.subscribe("IK_data");
    } else {
      Serial.print("failed, rc=");
      Serial.print(client.state());
      Serial.println(" try again in 5 seconds");
      // 5 секунд для повторного подключения
      delay(5000);
    }
  }
}

//Funсtions
//отправка данных с датчика пламени на Алису
void send_data() {
  client.publish(ir_topic, String(ir_data, 1).c_str(), false);
}
//включение пожарной сигнализации
void on_alarm() {
  on_off_light(0);
  Serial.println("Fire!!!");
  alarm_picture();

  alarm(400);

  open_close_door(1);
  delay(150);

  alarm(400);

  on_off_cooler(0);
  delay(150);

  alarm(400);

  on_off_power(0);
  delay(150);

  alarm(400);
}
//выключение пожарной сигнализации
void off_alarm(char status) {
  if (status == '1') {
    on_off_light(1);

    on_off_cooler(1);

    on_off_power(1);

    open_close_door(0);

    generic_TV_picture(1);
  }
}

//включение выключение света
void on_off_light(char status) {
  if (status == '1') {
    leds.setBrightness(0, 0xcc);
    leds2.setBrightness(0, 0xcc);
    leds3.setBrightness(0, 0xcc);

    leds.setBrightness(6, 0xcc);
    leds2.setBrightness(6, 0xcc);
    leds3.setBrightness(6, 0xcc);

    Serial.println("Lights ON");
  } else {
    leds.setBrightness(0, 0x00);
    leds2.setBrightness(0, 0x00);
    leds3.setBrightness(0, 0x00);

    leds.setBrightness(6, 0x00);
    leds2.setBrightness(6, 0x00);
    leds3.setBrightness(6, 0x00);

    Serial.println("Lights OFF");
  }
}

//включение выключение электричества
void on_off_power(char status) {
  if (status == '1') {
    ledcWrite(5, 1024);
    Serial.println("Power ON");
  } else {
    ledcWrite(5, 0);
    Serial.println("Power OFF");
  }
}

//включение выключение вентиляции
void on_off_cooler(char status) {
  if (status == '0') {
    digitalWrite(wind, HIGH);
    Serial.println("Cooler ON");
  } else {
    digitalWrite(wind, LOW);
    Serial.println("Cooler OFF");
  }
}

//открытие закрытие двери
void open_close_door(char status) {
  if (status == '1') {
    myservo.write(80);
    Serial.println("Door Open!");
  } else {
    myservo.write(170);
    Serial.println("Door Close!");
  }
}

//Картинка для ТВ
void generic_TV_picture(char status) {
    if (status == '1') {
      lcd.begin();
      lcd.gotoxy (0, 0);
      lcd.clear (0, 0, 128, 64, 0x00);
      lcd.blit (picture, sizeof picture);
      Serial.println("Display TV ON");
    } else {
      lcd.begin();
      lcd.gotoxy (0, 0);
      lcd.clear (0, 0, 128, 64, 0x00);
      Serial.println("Display TV OFF");
    }    
}

//Картинка тревоги на ТВ
void alarm_picture() {
  lcd.begin();
  lcd.gotoxy (0, 0);
  lcd.clear (0, 0, 128, 64, 0x00);
  lcd.gotoxy (10, 53); // устанавливаем курсор в координату (40,53)
  lcd.string ("Leave building now!", false); // пишем фразу для температуры
  lcd.gotoxy (25, 39); // устанавливаем курсор в координату (40,39)
  lcd.string ("Fire attempt!" , false);// пишем фразу для влажности
  lcd.gotoxy (40, 22); // устанавливаем курсор в координату (40,22)
  lcd.string ("Warning!", false); // пишем фразу для давления
  delay(150);
}

//Сирена
void alarm(int duration) {
  ton = 30;
  delay(10);
  for (int i = 0; i < duration; i++) {
    buzzer.setVoltage(vol1, false);
    buzzer.setVoltage(vol2, false);
    leds.setBrightness(3, 0xff);
    leds2.setBrightness(3, 0xff);
    leds3.setBrightness(3, 0xff);
    delayMicroseconds(ton);
  }

  leds.setBrightness(3, 0x00);
  leds2.setBrightness(3, 0x00);
  leds3.setBrightness(3, 0x00);

  buzzer.setVoltage(0, false);
}

/////////////////////////////////////////////////////////////////////////// все для музыки
void note( int type, int duration) {   // нота (какая нота, длительность)
  switch (type) {
    case 1:   ton = 1000; break;
    case 2:   ton = 860;  break;
    case 3:   ton = 800;  break;
    case 4:   ton = 700;  break;
    case 5:   ton = 600;  break;
    case 6:   ton = 525;  break;
    case 7:   ton = 450;  break;
    case 8:   ton = 380;  break;
    case 9:   ton = 315;  break;
    case 10:  ton = 250;  break;
    case 11:  ton = 190;  break;
    case 12:  ton = 130;  break;
    case 13:  ton = 80;   break;
    case 14:  ton = 30;   break;
    case 15:  ton = 1;   break;
  }
  delay(10);
  for (int i = 0; i < duration; i++) {
    buzzer.setVoltage(vol1, false);
    buzzer.setVoltage(vol2, false);
    leds.setBrightness(3, 0xff);
    leds2.setBrightness(3, 0xff);
    leds3.setBrightness(3, 0xff);
    delayMicroseconds(ton);
  }

  leds.setBrightness(3, 0x00);
  leds2.setBrightness(3, 0x00);
  leds3.setBrightness(3, 0x00);
}
/////////////////////////////////////////////////// для MGS-FR403 - датчик пламени
void init_sensor() {
  Wire.begin();
  Wire.beginTransmission(sensor_addr);
  Wire.write(0x81);       // Регистр времени интегрирования АЦП
  Wire.write(0b00111111); // 180 мс, 65535 циклов
  Wire.endTransmission();
  Wire.beginTransmission(sensor_addr);
  Wire.write(0x83);       // Регистр времени ожидания
  Wire.write(0b00111111); // 180 мс
  Wire.endTransmission();
  Wire.beginTransmission(sensor_addr);
  Wire.write(0x90);         // Регистр усиления
  Wire.write(0b00000000);   // Усиление 1x
  Wire.endTransmission();
  Wire.beginTransmission(sensor_addr);
  Wire.write(0x80);       // Регистр управления питанием
  Wire.write(0b00001011); // Включение ожидания, генератора, АЦП и ALS сенсора
  Wire.endTransmission();
}

// Получение данных с датчика
void poll_sensor() {
  unsigned int sensor_data[4];
  Wire.beginTransmission(sensor_addr);
  Wire.write(0x94); // Начальный адрес регистров данных
  Wire.endTransmission();
  Wire.requestFrom(sensor_addr, 4);
  if (Wire.available() == 4) {
    sensor_data[0] = Wire.read();
    sensor_data[1] = Wire.read();
    sensor_data[2] = Wire.read();
    sensor_data[3] = Wire.read();
  }
  ir_data   = sensor_data[3] * 256.0 + sensor_data[2];
  vis_data = sensor_data[1] * 256.0 + sensor_data[0];
}
